## config/west.yml
```yaml
manifest:
  remotes:
    - name: zmkfirmware
      url-base: https://github.com/zmkfirmware
    - name: cormoran
      url-base: https://github.com/cormoran
    - name: kumamuk-git
      url-base: https://github.com/kumamuk-git
  projects:
    # ZMK本体（DYA Studio対応のcormoran版 / v0.3ベース）
    - name: zmk
      remote: cormoran
      revision: v0.3-branch+dya
      import: app/west.yml
    # roBa用トラックボールドライバ
    - name: zmk-pmw3610-driver
      remote: kumamuk-git
      revision: main
    # DYA Studio用モジュール
    - name: zmk-module-ble-management
      remote: cormoran
      revision: zmk-v0.3.0.0
    - name: zmk-module-battery-history
      remote: cormoran
      revision: main
    - name: zmk-module-settings-rpc
      remote: cormoran
      revision: main
    - name: zmk-module-runtime-input-processor
      remote: cormoran
      revision: zmk-v0.3.0.0
    - name: zmk-behavior-runtime-sensor-rotate
      remote: cormoran
      revision: main
  self:
    path: config
```
